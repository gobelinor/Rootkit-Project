## linux-6.10.10/my_test/Kconfig
```kconfig
# my_test/Kconfig
config HAVE_SYSCALL_UPTIME
    bool "Enable uptime syscall"
    default y
    help
      This option adds the uptime syscall to get the system uptime.
      If unsure, say Y.
```
